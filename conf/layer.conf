## conf/layer.conf
```bitbake
# © Tietoevry 2023

BBPATH .= ":${LAYERDIR}"

BBFILES += "${LAYERDIR}/recipes-*/*/*.bb ${LAYERDIR}/recipes-*/*/*.bbappend"

BBFILE_COLLECTIONS += "matter"
BBFILE_PATTERN_matter:= "^${LAYERDIR}/"
BBFILE_PRIORITY_matter= "7"

LAYERSERIES_COMPAT_matter= "kirkstone"

# Enable OpenWRT
# Note: This is experimental feature and only secures flawless build of this layer for OpenWRT, runtime NOT TESTED!
# Usage: Set to 1 through variable expansion (ENABLE_OPENWRT = "1") in your layer.conf if you want to use OpenWRT as the default distribution instead of Poky
ENABLE_OPENWRT ??= "0"

IMAGE_INSTALL:append = "${@' matter avahi-daemon avahi-utils dbus' if '${ENABLE_OPENWRT}' == '1' else ' matter ot-br-posix-latest avahi-daemon avahi-utils mdns dbus'}"

# Host tool     Required by
# ------------|---------------------
# python3       matter general build
# node          otbr web frontend
# npm           otbr web frontend
HOSTTOOLS += "${@' python3' if '${ENABLE_OPENWRT}' == '1' else ' python3 node npm'}"
```
